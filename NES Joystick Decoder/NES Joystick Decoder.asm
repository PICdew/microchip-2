;==================================================================================================
;====================================  NES Joystic Decoder 1.0 ====================================
;================================== DERKACH OLEXANDR DEVELOPMENT ==================================
;========================================= (c) 2012 Alche =========================================
;=========================================  alche@ukr.net =========================================
;==================================================================================================

 #include	<P12F675.inc>				;файл стандартных определений
__CONFIG _INTRC_OSC_NOCLKOUT & _WDT_OFF & _PWRTE_ON & _MCLRE_OFF & _CP_OFF & _CPD_OFF

;==================================================================================================
;==================================== Раздел описания констант ====================================
;==================================================================================================
	#DEFINE PRER		GPIO,4			;Ввод даных
	#DEFINE CLK			GPIO,5			;Вывод синхроимпульса
	#DEFINE PS			GPIO,2			;Вывод записи в регистр
	#DEFINE OUT			GPIO,1			;Вывод результата

	CBLOCK	0x020
	rezult								;Ячейка результата
	cnt									;Ячейка счета
	temp								;Временная ячейка 1
	ENDC

PAUSE macro
	movlw	0xFF
	movwf	temp
	decfsz	temp
	goto	$-1
endm

org 0x000
	goto	START
;==================================================================================================
;==================================== Начальная  инициализация ====================================
;==================================================================================================
START
	clrf	INTCON						;Очистка регистра прерываний
	bsf		STATUS,RP0   				;Банк 1
	movlw	b'00000000'					;Значение для регистра OPTION
	movwf	OPTION_REG					;Поместили значение в регистр OPTION
  	bcf		STATUS,RP0					;Вернулись в Банк 0
	clrf	GPIO						;Очистили порт
	movlw	b'00000111'					;Значение для конфигурации компаратора (отключаем)
	movwf	CMCON						;Поместили в регистр конфигурации компаратора

	bsf		STATUS,RP0					;Переходим в банк 1
	movlw	b'00010000'					;Слово конфигурации для ANSEL, FOsc/2 GP0 аналоговый вход
	movwf	ANSEL						;Поместили слово в регистр
	movlw	b'00010000'					;GP4 вход, остальные выходы
	movwf	TRISIO						;Поместили в регистр конфигурации входов/выходов
	movlw	b'00010010'					;Слово конфигурации для WPU 
	movwf	WPU							;Включили подтягивающие резисторы

	bcf		STATUS,RP0					;Вернулись в банк 0
	movlw	b'10000001'					;Слово конфигурации для ADCON
	movwf	ADCON0						;Поместили слово в регистр

INIT
	clrf	rezult						;Очистили ячейку результата			
	bsf		CLK							;Установили 1 на выводе тактирования сдвигового регистра
	bsf		PS							;Дали команду регистру считать состояние выводов
	PAUSE								;Небольшая задержка
	bcf		PS							;Установили 0 на выводе PS

OPROS
	movlw	0x08						;Количество проходов для считывания выхода регистра
	movwf	cnt							;Поместили во временную ячейку счета
TAKTLOOP
	call	TAKT						;Будем тактировать вывод и считать результат
	decfsz	cnt							;Декримент ячейки счети
	goto	TAKTLOOP					;Если не 0 то на начало цикла
	incf	rezult						;Иначе инкриментируем результат
	decfsz	rezult						;Теперь декриментируем
 	goto	OUTREZULT					;Если резуьтат не ноль то будем его выводить
	goto	INIT						;Иначе будем опрашивать снова

TAKT
	rlf		rezult						;Сдвинем результат влево
	bsf		CLK							;Установим 1 на выводе сдвига регистра
	btfss	PRER						;Проверим состояние входа
	bsf		rezult,0					;Если пришел 0 то установим нулевой бит регистра результата в 1
	bcf		CLK							;Установим 0 на выводе сдвига регистра
 return									;и возвращаемся

OUTREZULT
	movfw	rezult						;Поместили в рабочий регистр результат
	movwf	cnt							;Рабочий регистр во временную ячейку счета
OUTLOOP
	bcf		OUT							;Установим 0 на выходе
	bsf		OUT							;установим 1 на выходе
	decfsz	cnt							;Уменьшим счетчик на 1, если счетчик не 0
	goto	OUTLOOP						;то на начало цикла
	goto	INIT						;иначе возвращаемся в самое начало
end